## drivers/misc/sunxi-tvutils/Kconfig
```kconfig
#
# sunxi system information driver.
#
#
config SUNXI_MIPSLOADER
	bool "enable sunxi mips firmware loader driver"
	depends on (ARCH_SUNXI)
	default n
	help
	  Choose Y to enable sunxi mips firmware loader driver

config SUNXI_TVUTILS
	bool "enable sunxi tv subsystem utils driver"
	depends on (ARCH_SUNXI)
	default n
	help
	  Choose Y to enable sunxi tv subsystem utils driver

config SUNXI_ARISC_RPM
	bool "enable sunxi remote processor messaging driver for arisc"
	depends on (ARCH_SUNXI)
    depends on (RPMSG_SUNXI_AMP)
	default n
	help
	  Choose Y to enable sunxi remote processor messaging driver for arisc
```

## drivers/net/wireless/aic8800/Kconfig
```kconfig
config AIC_WLAN_SUPPORT
	bool "AIC wireless Support"
	default n
	help
	  This is support for aic wireless chip.

choice
	prompt "Enable Chip Interface"
	depends on AIC_WLAN_SUPPORT
	---help---
		Enable Chip Interface.
config AIC_INTF_SDIO
		bool "SDIO interface support"
		depends on AIC_WLAN_SUPPORT && MMC
config AIC_INTF_USB
		bool "USB interface support"
		depends on AIC_WLAN_SUPPORT && USB
endchoice

if AIC_WLAN_SUPPORT
source "drivers/net/wireless/aic8800/aic8800_fdrv/Kconfig"
source "drivers/net/wireless/aic8800/aic8800_btlpm/Kconfig"
source "drivers/net/wireless/aic8800/aic8800_btusb/Kconfig"
endif
```

## drivers/net/wireless/xr819s/Kconfig
```kconfig
config XR819S_WLAN
	tristate "XR819S WLAN support"
	default n
	select CFG80211
	select AVERAGE
	select CRYPTO
	select CRYPTO_ARC4
	---help---
	  To compile this code as a module, choose M here.
```

## sound/soc/sunxi_v2/Kconfig
```kconfig
# common
config SND_SOC_SUNXI_PCM
	tristate

config SND_SOC_SUNXI_MACH
	tristate

# internal codec
config SND_SOC_SUNXI_SUN50IW9_CODEC
	tristate

# ahub temp
config SND_SOC_SUNXI_AHUB_TMP
	tristate


# menu select
menu "Allwinner Audio support"
	depends on ARCH_SUNXI

menu "Codec drivers"

config SND_SOC_SUNXI_INTERNALCODEC
	tristate "Allwinner INTERNAL CODEC support"
	select SND_SOC_SUNXI_SUN50IW9_CODEC if ARCH_SUN50IW9
	depends on ARCH_SUN50IW9
	help
	    Select Y or M to support INTERNAL CODEC Module in the Allwinner SoCs.

config SND_SOC_SUNXI_DUMMYCODEC
	tristate "Allwinner DUMMY CODEC support"
	help
	    Select Y or M to support DUMMY CODEC Module in the Allwinner SoCs.

endmenu

menu "Platform(Audio Interface) drivers"

# aaudio
config SND_SOC_SUNXI_AAUDIO
	tristate "Allwinner AAUDIO support"
	select REGMAP_MMIO
	select SND_SOC_GENERIC_DMAENGINE_PCM
	select SND_SOC_SUNXI_PCM
	select SND_SOC_SUNXI_MACH
	depends on ARCH_SUN50IW9
	help
	    Select Y or M to support AAUDIO Module in the Allwinner SoCs.

# spdif
config SND_SOC_SUNXI_SPDIF
	tristate "Allwinner SPDIF Support"
	select REGMAP_MMIO
	select SND_SOC_GENERIC_DMAENGINE_PCM
	select SND_SOC_SUNXI_PCM
	select SND_SOC_SUNXI_MACH
	depends on ARCH_SUN50IW9
	help
	    Select Y or M to support SPDIF Module in Allwinner SoCs.

# dmic
config SND_SOC_SUNXI_DMIC
	tristate "Allwinner DMIC support"
	select REGMAP_MMIO
	select SND_SOC_GENERIC_DMAENGINE_PCM
	select SND_SOC_SUNXI_PCM
	select SND_SOC_SUNXI_MACH
	depends on ARCH_SUN50IW9
	help
	    Select Y or M to support DMIC Module in Allwinner SoCs.

# daudio
config SND_SOC_SUNXI_DAUDIO
	tristate "Allwinner DAUDIO Support"
	select REGMAP_MMIO
	select SND_SOC_GENERIC_DMAENGINE_PCM
	select SND_SOC_SUNXI_PCM
	select SND_SOC_SUNXI_MACH
	depends on !ARCH_SUN50IW9
	help
	    Select Y or M to support I2S/PCM/TDM Module in Allwinner SoCs.

# ahub
config SND_SOC_SUNXI_AHUB
	tristate "Allwinner AHUB Support"
	select REGMAP_MMIO
	select SND_SOC_GENERIC_DMAENGINE_PCM
	select SND_SOC_SUNXI_PCM
#	select SND_SOC_SUNXI_MACH
	select SND_SOC_SUNXI_AHUB_TMP
	depends on ARCH_SUN50IW9
	help
	    Select Y or M to support AHUB Module in Allwinner SoCs.

endmenu

endmenu
```
